## config/west.yml
```yaml
manifest:
  remotes:
    - name: zmkfirmware
      url-base: https://github.com/zmkfirmware
    - name: cormoran
      url-base: https://github.com/cormoran
    - name: caksoylar  # <-- RGB LED
      url-base: https://github.com/caksoylar
  projects:
    - name: zmk
      remote: cormoran
      revision: 3931facea7507151a53f209ca4f8a717fa6bd400 # v0.3-branch+dya
      import: app/west.yml
    - name: zmk-rgbled-widget
      remote: caksoylar
      revision: 8756cb7b8114069fa3c25c6f6c990f24988fceff # v0.3
    - name: zmk-feature-runtime-macro
      remote: cormoran
      revision: 38530962eb7061b60efcb98e84585cfb1f0cb6de # main
      import: true
    - name: zmk-module-settings-rpc
      remote: cormoran
      revision: 78f86df9e6c5edaf57bef3ccbd7f360cfdf49291 # main
  self:
    path: config
```
